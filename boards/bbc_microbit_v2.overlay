/*
 * Copyright (c) 2024 Takayuki Goto <tkg.develop@gmail.com>
 *
 * SPDX-License-Identifier: Apache-2.0
 */

/ {
	zephyr,user {
		/* period cell corresponds to initial period */
		pwms = <&pwm1 0 PWM_USEC(1500) PWM_POLARITY_NORMAL>;
	};
};
